/**
 * @cliArgs --board "/boards/TMDSCNCD2800157" --context "system" --product "C2000WARE@5.02.00.00"
 * @versions {"tool":"1.15.0+2826"}
 */

/**
 * Import the modules used in this configuration.
 */
const adc        = scripting.addModule("/driverlib/adc.js");
const adc1       = adc.addInstance();
const adc2       = adc.addInstance();
const analog     = scripting.addModule("/driverlib/analog.js", {}, false);
const analog1    = analog.addInstance();
const asysctl    = scripting.addModule("/driverlib/asysctl.js");
const led        = scripting.addModule("/driverlib/board_components/led", {}, false);
const led1       = led.addInstance();
const cmpss      = scripting.addModule("/driverlib/cmpss.js", {}, false);
const cmpss1     = cmpss.addInstance();
const cputimer   = scripting.addModule("/driverlib/cputimer.js", {}, false);
const cputimer1  = cputimer.addInstance();
const epwm       = scripting.addModule("/driverlib/epwm.js", {}, false);
const epwm1      = epwm.addInstance();
const epwm2      = epwm.addInstance();
const epwm3      = epwm.addInstance();
const epwmxbar   = scripting.addModule("/driverlib/epwmxbar.js", {}, false);
const epwmxbar1  = epwmxbar.addInstance();
const gpio       = scripting.addModule("/driverlib/gpio.js", {}, false);
const gpio1      = gpio.addInstance();
const gpio2      = gpio.addInstance();
const gpio3      = gpio.addInstance();
const inputxbar  = scripting.addModule("/driverlib/inputxbar.js", {}, false);
const inputxbar1 = inputxbar.addInstance();
const mcan       = scripting.addModule("/driverlib/mcan.js", {}, false);
const mcan1      = mcan.addInstance();
const spi        = scripting.addModule("/driverlib/spi.js", {}, false);
const spi1       = spi.addInstance();
const sysctl     = scripting.addModule("/driverlib/sysctl.js");

/**
 * Write custom configuration values to the imported modules.
 */
adc1.soc1Trigger              = "ADC_TRIGGER_EPWM1_SOCA";
adc1.$name                    = "MTR1_ADCA";
adc1.soc0Trigger              = "ADC_TRIGGER_EPWM1_SOCA";
adc1.soc1SampleWindow         = 20;
adc1.enabledInts              = ["ADC_INT_NUMBER1"];
adc1.enableInterrupt1         = true;
adc1.registerInterrupts       = ["1"];
adc1.socHighPriorityMode      = "ADC_PRI_THRU_SOC1_HIPRI";
adc1.soc1IndependentNameMode  = true;
adc1.soc2IndependentNameMode  = true;
adc1.ppb1IndependentNameMode  = true;
adc1.soc0IndependentNameMode  = true;
adc1.adcClockPrescaler        = "ADC_CLK_DIV_2_0";
adc1.soc0SampleWindow         = 20;
adc1.enabledSOCs              = ["ADC_SOC_NUMBER0","ADC_SOC_NUMBER1","ADC_SOC_NUMBER2","ADC_SOC_NUMBER3","ADC_SOC_NUMBER4","ADC_SOC_NUMBER5"];
adc1.soc3Name                 = "MTR1_IDC2_SOC";
adc1.soc3Channel              = "ADC_CH_ADCIN6";
adc1.soc4Name                 = "MTR1_IDC3_SOC";
adc1.soc4IndependentNameMode  = true;
adc1.soc3IndependentNameMode  = true;
adc1.soc4Channel              = "ADC_CH_ADCIN6";
adc1.soc5Name                 = "MTR1_IDC4_SOC";
adc1.soc5Channel              = "ADC_CH_ADCIN6";
adc1.soc5IndependentNameMode  = true;
adc1.enabledPPBs              = ["ADC_PPB_NUMBER1","ADC_PPB_NUMBER2","ADC_PPB_NUMBER3","ADC_PPB_NUMBER4"];
adc1.ppb1Name                 = "MTR1_IDC1_PPB";
adc1.ppb2Name                 = "MTR1_IDC2_PPB";
adc1.ppb2SOCNumber            = "ADC_SOC_NUMBER3";
adc1.ppb3Name                 = "MTR1_IDC3_PPB";
adc1.ppb3SOCNumber            = "ADC_SOC_NUMBER4";
adc1.ppb4SOCNumber            = "ADC_SOC_NUMBER5";
adc1.soc0Name                 = "MTR1_VU_SOC";
adc1.soc0Channel              = "ADC_CH_ADCIN3";
adc1.soc1Name                 = "MTR1_VDC_SOC";
adc1.soc2Name                 = "MTR1_IDC1_SOC";
adc1.soc1Channel              = "ADC_CH_ADCIN8";
adc1.soc2Channel              = "ADC_CH_ADCIN6";
adc1.soc2Trigger              = "ADC_TRIGGER_EPWM2_SOCA";
adc1.soc3Trigger              = "ADC_TRIGGER_EPWM2_SOCB";
adc1.soc4Trigger              = "ADC_TRIGGER_EPWM3_SOCA";
adc1.soc5Trigger              = "ADC_TRIGGER_EPWM3_SOCB";
adc1.ppb4Name                 = "MTR1_IDC4_PPB";
adc1.ppb4IndependentNameMode  = true;
adc1.ppb3IndependentNameMode  = true;
adc1.ppb2IndependentNameMode  = true;
adc1.ppb1SOCNumber            = "ADC_SOC_NUMBER2";
adc1.interrupt1SOCSource      = "ADC_SOC_NUMBER1";
adc1.soc2SampleWindow         = 14;
adc1.soc3SampleWindow         = 14;
adc1.soc4SampleWindow         = 14;
adc1.soc5SampleWindow         = 14;
adc1.adcInt1.enableInterrupt  = true;
adc1.adcInt1.interruptHandler = "motor1CtrlISR";

adc2.socHighPriorityMode     = "ADC_PRI_THRU_SOC1_HIPRI";
adc2.soc0IndependentNameMode = true;
adc2.soc1IndependentNameMode = true;
adc2.ppb1IndependentNameMode = true;
adc2.adcClockPrescaler       = "ADC_CLK_DIV_2_0";
adc2.soc1Trigger             = "ADC_TRIGGER_EPWM2_SOCA";
adc2.soc0SampleWindow        = 20;
adc2.soc0Trigger             = "ADC_TRIGGER_EPWM1_SOCA";
adc2.adcBase                 = "ADCC_BASE";
adc2.$name                   = "MTR1_ADCC";
adc2.soc0Name                = "MTR1_VV_SOC";
adc2.soc0Channel             = "ADC_CH_ADCIN6";
adc2.soc1Name                = "MTR1_VW_SOC";
adc2.soc1SampleWindow        = 20;
adc2.enabledSOCs             = ["ADC_SOC_NUMBER0","ADC_SOC_NUMBER1"];
adc2.soc1Channel             = "ADC_CH_ADCIN2";

asysctl.analogReference         = "INTERNAL";
asysctl.analogReferenceVoltage  = "1P65";
asysctl.enableTemperatureSensor = true;

led1.$name                  = "LED2";
led1.$hardware              = system.deviceData.board.components.D2;
led1.gpio.writeInitialValue = true;
led1.gpio.initialValue      = 1;
led1.gpio.$name             = "GPIO_LED2";
led1.gpio.gpioPin.$assign   = "hsecDigital.96";

cmpss1.enableModule        = true;
cmpss1.initFilterLow       = true;
cmpss1.clearFilterLatchLow = true;
cmpss1.samplePrescaleLow   = 32;
cmpss1.sampleWindowLow     = 32;
cmpss1.thresholdLow        = 30;
cmpss1.highCTRIPOUT        = "CMPSS_TRIPOUT_FILTER";
cmpss1.highCTRIP           = "CMPSS_TRIP_FILTER";
cmpss1.lowCTRIPOUT         = "CMPSS_TRIPOUT_FILTER";
cmpss1.lowCTRIP            = "CMPSS_TRIP_FILTER";
cmpss1.hysteresisVal       = "1";
cmpss1.$name               = "MTR1_CMPSS_IDC";
cmpss1.samplePrescaleHigh  = 32;
cmpss1.sampleWindowHigh    = 32;
cmpss1.thresholdHigh       = 30;
cmpss1.initFilterHigh      = true;
cmpss1.useRampValShdw      = "false";
cmpss1.asysCMPHPMXSELValue = "2";
cmpss1.asysCMPHNMXSELValue = "0";
cmpss1.asysCMPLPMXSELValue = "2";
cmpss1.asysCMPLNMXSELValue = "0";
cmpss1.dacValLow           = 3500;
cmpss1.highCompInvert      = true;
cmpss1.dacValHigh          = 512;

adc1.analog                                   = analog1;
adc2.analog                                   = analog1;
analog1.useCase                               = "CUSTOM";
analog1.$name                                 = "MOTOR_FEEDBACK";
cmpss1.analog                                 = analog1;
analog1.useInterfacePins                      = ["A0/C15/CMP1_DACL","A15/C7","A3/C5, GPIO242","A5/C2","A6, GPIO228","A8/C11","C6, GPIO226"];
analog1.analog.$assign                        = "ANALOG";
analog1.analog["a0/c15/cmp1_daclPin"].$assign = "hsecAnalog.9";
analog1.analog["a15/c7Pin"].$assign           = "hsecAnalog.18";
analog1.analog["a3/c5, gpio242Pin"].$assign   = "hsecAnalog.17";
analog1.analog["a5/c2Pin"].$assign            = "hsecAnalog.23";
analog1.analog["a6, gpio228Pin"].$assign      = "hsecAnalog.25";
analog1.analog["a8/c11Pin"].$assign           = "hsecAnalog.30";
analog1.analog["c6, gpio226Pin"].$assign      = "hsecAnalog.20";

cputimer1.timerPeriod   = 120000;
cputimer1.startTimer    = true;
cputimer1.emulationMode = "CPUTIMER_EMULATIONMODE_RUNFREE";
cputimer1.$name         = "TIMEBASE_TIMER";

epwm1.epwmDeadband_polarityFED                                        = "EPWM_DB_POLARITY_ACTIVE_LOW";
epwm1.$name                                                           = "MTR1_PWM_U";
epwm1.useCase                                                         = "CUSTOM";
epwm1.useInterfacePins                                                = ["EPWM#_A","EPWM#_B"];
epwm1.epwmDeadband_enableRED                                          = true;
epwm1.epwmDeadband_enableFED                                          = true;
epwm1.epwmDeadband_delayRED                                           = 10;
epwm1.epwmDeadband_delayFED                                           = 10;
epwm1.epwmTimebase_hsClockDiv                                         = "EPWM_HSCLOCK_DIVIDER_1";
epwm1.epwmTimebase_counterMode                                        = "EPWM_COUNTER_MODE_UP_DOWN";
epwm1.epwmTimebase_emulationMode                                      = "EPWM_EMULATION_FREE_RUN";
epwm1.epwmActionQualifier_EPWM_AQ_OUTPUT_A_shadowMode                 = true;
epwm1.epwmActionQualifier_EPWM_AQ_OUTPUT_A_ON_TIMEBASE_ZERO           = "EPWM_AQ_OUTPUT_LOW";
epwm1.epwmActionQualifier_EPWM_AQ_OUTPUT_A_ON_TIMEBASE_PERIOD         = "EPWM_AQ_OUTPUT_HIGH";
epwm1.epwmActionQualifier_EPWM_AQ_OUTPUT_A_ON_TIMEBASE_UP_CMPA        = "EPWM_AQ_OUTPUT_HIGH";
epwm1.epwmEventTrigger_EPWM_SOC_A_triggerEnable                       = true;
epwm1.epwmEventTrigger_EPWM_SOC_A_triggerEventPrescalar               = "1";
epwm1.epwmEventTrigger_EPWM_SOC_A_triggerSource                       = "EPWM_SOC_TBCTR_D_CMPC";
epwm1.epwmTimebase_counterModeAfterSync                               = "EPWM_COUNT_MODE_UP_AFTER_SYNC";
epwm1.hrpwm_syncSource                                                = "HRPWM_PWMSYNC_SOURCE_ZERO";
epwm1.epwmActionQualifier_EPWM_AQ_OUTPUT_B_shadowMode                 = true;
epwm1.epwmEventTrigger_enableInterrupt                                = true;
epwm1.epwmEventTrigger_interruptSource                                = "EPWM_INT_TBCTR_ZERO";
epwm1.epwmEventTrigger_interruptEventCount                            = "1";
epwm1.epwmDigitalCompare_EPWM_DC_TYPE_DCAH_combinationInputConfig     = ["EPWM_DC_COMBINATIONAL_TRIPIN7"];
epwm1.epwmDigitalCompare_EPWM_TZ_DC_OUTPUT_A1                         = "EPWM_TZ_EVENT_DCXH_HIGH";
epwm1.epwmDigitalCompare_EPWM_DC_MODULE_A_EPWM_DC_EVENT_1_eventSource = "EPWM_DC_EVENT_SOURCE_FILT_SIGNAL";
epwm1.epwmDigitalCompare_EPWM_DC_TYPE_DCBH_combinationInputConfig     = ["EPWM_DC_COMBINATIONAL_TRIPIN7"];
epwm1.epwmDigitalCompare_EPWM_DC_MODULE_B_EPWM_DC_EVENT_1_eventSource = "EPWM_DC_EVENT_SOURCE_FILT_SIGNAL";
epwm1.codeTemplateName                                                = "";
epwm1.epwmTripZone_cbcSource                                          = ["EPWM_TZ_SIGNAL_CBC6"];
epwm1.epwmTripZone_EPWM_TZ_ACTION_EVENT_TZB                           = "EPWM_TZ_ACTION_LOW";
epwm1.epwmTripZone_EPWM_TZ_ACTION_EVENT_TZA                           = "EPWM_TZ_ACTION_LOW";
epwm1.epwmTripZone_oneShotSource                                      = ["EPWM_TZ_SIGNAL_DCAEVT1","EPWM_TZ_SIGNAL_DCBEVT1"];
epwm1.epwmDigitalCompare_EPWM_DC_MODULE_B_EPWM_DC_EVENT_1_eventSync   = "EPWM_DC_EVENT_INPUT_NOT_SYNCED";
epwm1.epwmDigitalCompare_EPWM_DC_MODULE_A_EPWM_DC_EVENT_1_eventSync   = "EPWM_DC_EVENT_INPUT_NOT_SYNCED";
epwm1.epwmActionQualifier_EPWM_AQ_OUTPUT_A_ON_TIMEBASE_DOWN_CMPB      = "EPWM_AQ_OUTPUT_LOW";
epwm1.epwmDigitalCompare_EPWM_TZ_DC_OUTPUT_B1                         = "EPWM_TZ_EVENT_DCXL_HIGH";
epwm1.epwmDigitalCompare_EPWM_DC_TYPE_DCAH                            = "EPWM_DC_TRIP_COMBINATION";
epwm1.epwmDigitalCompare_EPWM_DC_TYPE_DCBH                            = "EPWM_DC_TRIP_COMBINATION";
epwm1.epwm.$assign                                                    = "EPWM1";
epwm1.epwm.epwm_aPin.$assign                                          = "hsecDigital.49";
epwm1.epwm.epwm_bPin.$assign                                          = "hsecDigital.51";
epwm1.aQual.$name                                                     = "myGPIOQUAL8";
epwm1.bQual.$name                                                     = "myGPIOQUAL9";
scripting.suppress("Connected to hardware,@@@.+?@@@ is connected to EPWM1 on the Control Card F2800157\\. Consider selecting it in 'use hardware' above\\. @@@.+?@@@", epwm1.epwm, "epwm_aPin");
scripting.suppress("Connected to hardware,@@@.+?@@@ is connected to EPWM1 on the Control Card F2800157\\. Consider selecting it in 'use hardware' above\\. @@@.+?@@@", epwm1.epwm, "epwm_bPin");

epwm2.epwmTripZone_oneShotSource                                      = ["EPWM_TZ_SIGNAL_DCAEVT1","EPWM_TZ_SIGNAL_DCBEVT1"];
epwm2.epwmTripZone_cbcSource                                          = ["EPWM_TZ_SIGNAL_CBC6"];
epwm2.epwmDigitalCompare_EPWM_DC_MODULE_A_EPWM_DC_EVENT_1_eventSync   = "EPWM_DC_EVENT_INPUT_NOT_SYNCED";
epwm2.epwmDigitalCompare_EPWM_DC_MODULE_B_EPWM_DC_EVENT_1_eventSync   = "EPWM_DC_EVENT_INPUT_NOT_SYNCED";
epwm2.$name                                                           = "MTR1_PWM_V";
epwm2.useCase                                                         = "CUSTOM";
epwm2.useInterfacePins                                                = ["EPWM#_A","EPWM#_B"];
epwm2.epwmDeadband_polarityFED                                        = "EPWM_DB_POLARITY_ACTIVE_LOW";
epwm2.epwmDeadband_enableRED                                          = true;
epwm2.epwmDeadband_delayRED                                           = 10;
epwm2.epwmDeadband_enableFED                                          = true;
epwm2.epwmDeadband_delayFED                                           = 10;
epwm2.epwmDigitalCompare_EPWM_DC_TYPE_DCAH_combinationInputConfig     = ["EPWM_DC_COMBINATIONAL_TRIPIN7"];
epwm2.epwmDigitalCompare_EPWM_TZ_DC_OUTPUT_A1                         = "EPWM_TZ_EVENT_DCXH_HIGH";
epwm2.epwmDigitalCompare_EPWM_DC_MODULE_A_EPWM_DC_EVENT_1_eventSource = "EPWM_DC_EVENT_SOURCE_FILT_SIGNAL";
epwm2.epwmDigitalCompare_EPWM_DC_TYPE_DCBH_combinationInputConfig     = ["EPWM_DC_COMBINATIONAL_TRIPIN7"];
epwm2.epwmDigitalCompare_EPWM_TZ_DC_OUTPUT_B1                         = "EPWM_TZ_EVENT_DCXL_HIGH";
epwm2.epwmDigitalCompare_EPWM_DC_MODULE_B_EPWM_DC_EVENT_1_eventSource = "EPWM_DC_EVENT_SOURCE_FILT_SIGNAL";
epwm2.epwmTimebase_counterModeAfterSync                               = "EPWM_COUNT_MODE_UP_AFTER_SYNC";
epwm2.hrpwm_syncSource                                                = "HRPWM_PWMSYNC_SOURCE_ZERO";
epwm2.epwmActionQualifier_EPWM_AQ_OUTPUT_B_shadowMode                 = true;
epwm2.epwmTripZone_EPWM_TZ_ACTION_EVENT_TZA                           = "EPWM_TZ_ACTION_LOW";
epwm2.epwmTripZone_EPWM_TZ_ACTION_EVENT_TZB                           = "EPWM_TZ_ACTION_LOW";
epwm2.epwmTimebase_emulationMode                                      = "EPWM_EMULATION_FREE_RUN";
epwm2.epwmTimebase_hsClockDiv                                         = "EPWM_HSCLOCK_DIVIDER_1";
epwm2.epwmTimebase_counterMode                                        = "EPWM_COUNTER_MODE_UP_DOWN";
epwm2.epwmActionQualifier_EPWM_AQ_OUTPUT_A_shadowMode                 = true;
epwm2.epwmActionQualifier_EPWM_AQ_OUTPUT_A_ON_TIMEBASE_ZERO           = "EPWM_AQ_OUTPUT_LOW";
epwm2.epwmActionQualifier_EPWM_AQ_OUTPUT_A_ON_TIMEBASE_PERIOD         = "EPWM_AQ_OUTPUT_HIGH";
epwm2.epwmActionQualifier_EPWM_AQ_OUTPUT_A_ON_TIMEBASE_UP_CMPA        = "EPWM_AQ_OUTPUT_HIGH";
epwm2.copyUse                                                         = true;
epwm2.copyFrom                                                        = "MTR1_PWM_U";
epwm2.codeTemplateName                                                = "";
epwm2.epwmDigitalCompare_EPWM_DC_TYPE_DCAH                            = "EPWM_DC_TRIP_COMBINATION";
epwm2.epwmDigitalCompare_EPWM_DC_TYPE_DCBH                            = "EPWM_DC_TRIP_COMBINATION";
epwm2.epwmActionQualifier_EPWM_AQ_OUTPUT_A_ON_TIMEBASE_DOWN_CMPB      = "EPWM_AQ_OUTPUT_LOW";
epwm2.epwmEventTrigger_EPWM_SOC_A_triggerEnable                       = true;
epwm2.epwmEventTrigger_EPWM_SOC_B_triggerEnable                       = true;
epwm2.epwmEventTrigger_EPWM_SOC_A_triggerSource                       = "EPWM_SOC_TBCTR_U_CMPC";
epwm2.epwmEventTrigger_EPWM_SOC_B_triggerSource                       = "EPWM_SOC_TBCTR_U_CMPD";
epwm2.epwm.$assign                                                    = "EPWM2";
epwm2.epwm.epwm_aPin.$assign                                          = "hsecDigital.53";
epwm2.epwm.epwm_bPin.$assign                                          = "hsecDigital.55";
epwm2.aQual.$name                                                     = "myGPIOQUAL2";
epwm2.bQual.$name                                                     = "myGPIOQUAL3";
scripting.suppress("Connected to hardware,@@@.+?@@@ is connected to EPWM2 on the Control Card F2800157\\. Consider selecting it in 'use hardware' above\\. @@@.+?@@@", epwm2.epwm, "epwm_aPin");
scripting.suppress("Connected to hardware,@@@.+?@@@ is connected to EPWM2 on the Control Card F2800157\\. Consider selecting it in 'use hardware' above\\. @@@.+?@@@", epwm2.epwm, "epwm_bPin");

epwm3.epwmTripZone_oneShotSource                                      = ["EPWM_TZ_SIGNAL_DCAEVT1","EPWM_TZ_SIGNAL_DCBEVT1"];
epwm3.epwmTripZone_cbcSource                                          = ["EPWM_TZ_SIGNAL_CBC6"];
epwm3.epwmDigitalCompare_EPWM_DC_MODULE_A_EPWM_DC_EVENT_1_eventSync   = "EPWM_DC_EVENT_INPUT_NOT_SYNCED";
epwm3.epwmDigitalCompare_EPWM_DC_MODULE_B_EPWM_DC_EVENT_1_eventSync   = "EPWM_DC_EVENT_INPUT_NOT_SYNCED";
epwm3.epwmDigitalCompare_EPWM_DC_TYPE_DCAH_combinationInputConfig     = ["EPWM_DC_COMBINATIONAL_TRIPIN7"];
epwm3.epwmDigitalCompare_EPWM_TZ_DC_OUTPUT_A1                         = "EPWM_TZ_EVENT_DCXH_HIGH";
epwm3.epwmDigitalCompare_EPWM_DC_MODULE_A_EPWM_DC_EVENT_1_eventSource = "EPWM_DC_EVENT_SOURCE_FILT_SIGNAL";
epwm3.epwmDigitalCompare_EPWM_DC_TYPE_DCBH_combinationInputConfig     = ["EPWM_DC_COMBINATIONAL_TRIPIN7"];
epwm3.epwmDigitalCompare_EPWM_TZ_DC_OUTPUT_B1                         = "EPWM_TZ_EVENT_DCXL_HIGH";
epwm3.epwmDigitalCompare_EPWM_DC_MODULE_B_EPWM_DC_EVENT_1_eventSource = "EPWM_DC_EVENT_SOURCE_FILT_SIGNAL";
epwm3.epwmTimebase_counterModeAfterSync                               = "EPWM_COUNT_MODE_UP_AFTER_SYNC";
epwm3.hrpwm_syncSource                                                = "HRPWM_PWMSYNC_SOURCE_ZERO";
epwm3.epwmActionQualifier_EPWM_AQ_OUTPUT_B_shadowMode                 = true;
epwm3.epwmTripZone_EPWM_TZ_ACTION_EVENT_TZA                           = "EPWM_TZ_ACTION_LOW";
epwm3.epwmTripZone_EPWM_TZ_ACTION_EVENT_TZB                           = "EPWM_TZ_ACTION_LOW";
epwm3.epwmTimebase_emulationMode                                      = "EPWM_EMULATION_FREE_RUN";
epwm3.epwmTimebase_hsClockDiv                                         = "EPWM_HSCLOCK_DIVIDER_1";
epwm3.epwmTimebase_counterMode                                        = "EPWM_COUNTER_MODE_UP_DOWN";
epwm3.epwmActionQualifier_EPWM_AQ_OUTPUT_A_shadowMode                 = true;
epwm3.epwmActionQualifier_EPWM_AQ_OUTPUT_A_ON_TIMEBASE_ZERO           = "EPWM_AQ_OUTPUT_LOW";
epwm3.epwmActionQualifier_EPWM_AQ_OUTPUT_A_ON_TIMEBASE_PERIOD         = "EPWM_AQ_OUTPUT_HIGH";
epwm3.epwmActionQualifier_EPWM_AQ_OUTPUT_A_ON_TIMEBASE_UP_CMPA        = "EPWM_AQ_OUTPUT_HIGH";
epwm3.epwmDeadband_polarityFED                                        = "EPWM_DB_POLARITY_ACTIVE_LOW";
epwm3.epwmDeadband_enableRED                                          = true;
epwm3.epwmDeadband_delayRED                                           = 10;
epwm3.epwmDeadband_enableFED                                          = true;
epwm3.epwmDeadband_delayFED                                           = 10;
epwm3.$name                                                           = "MTR1_PWM_W";
epwm3.useCase                                                         = "CUSTOM";
epwm3.useInterfacePins                                                = ["EPWM#_A","EPWM#_B"];
epwm3.copyUse                                                         = true;
epwm3.copyFrom                                                        = "MTR1_PWM_U";
epwm3.codeTemplateName                                                = "";
epwm3.epwmDigitalCompare_EPWM_DC_TYPE_DCAH                            = "EPWM_DC_TRIP_COMBINATION";
epwm3.epwmDigitalCompare_EPWM_DC_TYPE_DCBH                            = "EPWM_DC_TRIP_COMBINATION";
epwm3.epwmActionQualifier_EPWM_AQ_OUTPUT_A_ON_TIMEBASE_DOWN_CMPB      = "EPWM_AQ_OUTPUT_LOW";
epwm3.epwmEventTrigger_EPWM_SOC_A_triggerEnable                       = true;
epwm3.epwmEventTrigger_EPWM_SOC_A_triggerSource                       = "EPWM_SOC_TBCTR_D_CMPC";
epwm3.epwmEventTrigger_EPWM_SOC_B_triggerEnable                       = true;
epwm3.epwmEventTrigger_EPWM_SOC_B_triggerSource                       = "EPWM_SOC_TBCTR_D_CMPD";
epwm3.epwm.$assign                                                    = "EPWM3";
epwm3.epwm.epwm_aPin.$assign                                          = "hsecDigital.50";
epwm3.epwm.epwm_bPin.$assign                                          = "hsecDigital.52";
epwm3.aQual.$name                                                     = "myGPIOQUAL4";
epwm3.bQual.$name                                                     = "myGPIOQUAL5";
scripting.suppress("Connected to hardware,@@@.+?@@@ is connected to EPWM3 on the Control Card F2800157\\. Consider selecting it in 'use hardware' above\\. @@@.+?@@@", epwm3.epwm, "epwm_aPin");
scripting.suppress("Connected to hardware,@@@.+?@@@ is connected to EPWM3 on the Control Card F2800157\\. Consider selecting it in 'use hardware' above\\. @@@.+?@@@", epwm3.epwm, "epwm_bPin");

epwmxbar1.tripInput       = "XBAR_TRIP7";
epwmxbar1.$name           = "MTR1_IS_XBAR_EPWM_MUX";
epwmxbar1.useSourceSelect = true;
epwmxbar1.sourceSignals   = ["CMPSS1_CTRIPH"];

gpio1.writeInitialValue = true;
gpio1.direction         = "GPIO_DIR_MODE_OUT";
gpio1.$name             = "GPIO_SYS_DIS_FET_SUPPLY";
gpio1.gpioPin.$assign   = "hsecDigital.56";
scripting.suppress("Connected to hardware,@@@.+?@@@ is connected to EPWM4 on the Control Card F2800157\\. Consider selecting it in 'use hardware' above\\. @@@.+?@@@", gpio1, "gpioPin");

gpio2.direction       = "GPIO_DIR_MODE_OUT";
gpio2.$name           = "GPIO_SYS_WDOG_OUT";
gpio2.gpioPin.$assign = "hsecDigital.69";
scripting.suppress("Connected to hardware,@@@.+?@@@ is connected to SPIA on the Control Card F2800157\\. Consider selecting it in 'use hardware' above\\. @@@.+?@@@", gpio2, "gpioPin");

gpio3.direction       = "GPIO_DIR_MODE_OUT";
gpio3.$name           = "GPIO_SYS_WDOG_DIS";
gpio3.gpioPin.$assign = "hsecDigital.67";
scripting.suppress("Connected to hardware,@@@.+?@@@ is connected to SPIA on the Control Card F2800157\\. Consider selecting it in 'use hardware' above\\. @@@.+?@@@", gpio3, "gpioPin");

inputxbar1.$name = "MTR1_XBAR_INPUT1";

mcan1.loopbackMode            = false;
mcan1.nomRatePrescalar        = 3;
mcan1.nomTimeSeg1             = 9;
mcan1.nomTimeSeg2             = 8;
mcan1.nomSynchJumpWidth       = 8;
mcan1.dataRatePrescalar       = 1;
mcan1.dataTimeSeg1            = 9;
mcan1.dataTimeSeg2            = 8;
mcan1.dataSynchJumpWidth      = 8;
mcan1.enableInterrupt         = true;
mcan1.interruptFlags          = ["MCAN_INTR_MASK_ALL"];
mcan1.interruptLine           = ["MCAN_INTR_LINE_NUM_0"];
mcan1.interruptLine0Flag      = ["MCAN_INTR_MASK_ALL"];
mcan1.$name                   = "MCAN_COM";
mcan1.txBufElemSize           = "MCAN_ELEM_SIZE_8BYTES";
mcan1.rxFIFO0size             = 1;
mcan1.txBufNum                = 1;
mcan1.rxBufElemSize           = "MCAN_ELEM_SIZE_8BYTES";
mcan1.rxFIFO0ElemSize         = "MCAN_ELEM_SIZE_8BYTES";
mcan1.rxFIFO1ElemSize         = "MCAN_ELEM_SIZE_8BYTES";
mcan1.rxFIFO1size             = 0;
mcan1.txEventFIFOWaterMark    = 0;
mcan1.txEventFIFOStartAddr    = 0;
mcan1.txEventFIFOSize         = 0;
mcan1.tdcConfig_tdcf          = 0;
mcan1.tdcConfig_tdco          = 0;
mcan1.wdcPreload              = 0;
mcan1.lse                     = 0;
mcan1.flesa                   = 0;
mcan1.mcan.$assign            = "MCAN";
mcan1.mcan.mcan_rxPin.$assign = "hsecDigital.80";
mcan1.mcan.mcan_txPin.$assign = "hsecDigital.82";
mcan1.rxQual.$name            = "myGPIOQUAL6";
mcan1.txQual.$name            = "myGPIOQUAL7";
scripting.suppress("Connected to hardware,@@@.+?@@@ is connected to CANA on the Control Card F2800157\\. Consider selecting it in 'use hardware' above\\. @@@.+?@@@", mcan1.mcan, "mcan_rxPin");
scripting.suppress("Connected to hardware,@@@.+?@@@ is connected to CANA on the Control Card F2800157\\. Consider selecting it in 'use hardware' above\\. @@@.+?@@@", mcan1.mcan, "mcan_txPin");

spi1.$name                   = "DAC128S_SPI";
spi1.mode                    = "SPI_MODE_CONTROLLER";
spi1.emulationMode           = "SPI_EMULATION_FREE_RUN";
spi1.bitRate                 = 1500000;
spi1.txFifo                  = "SPI_FIFO_TX4";
spi1.rxFifo                  = "SPI_FIFO_RX4";
spi1.spi.$assign             = "SPIA";
spi1.spi.spi_picoPin.$assign = "hsecDigital.57";
spi1.spi.spi_pociPin.$assign = "hsecDigital.61";
spi1.spi.spi_clkPin.$assign  = "hsecDigital.59";
spi1.spi.spi_ptePin.$assign  = "hsecDigital.63";
scripting.suppress("Connected to hardware,@@@.+?@@@ is connected to EPWM5 on the Control Card F2800157\\. Consider selecting it in 'use hardware' above\\. @@@.+?@@@", spi1.spi, "spi_picoPin");
scripting.suppress("Connected to hardware,@@@.+?@@@ is connected to EPWM6 ALT on the Control Card F2800157\\. Consider selecting it in 'use hardware' above\\. @@@.+?@@@", spi1.spi, "spi_pociPin");
scripting.suppress("Connected to hardware,@@@.+?@@@ is connected to EPWM5 on the Control Card F2800157\\. Consider selecting it in 'use hardware' above\\. @@@.+?@@@", spi1.spi, "spi_clkPin");
scripting.suppress("Connected to hardware,@@@.+?@@@ is connected to EPWM6 ALT on the Control Card F2800157\\. Consider selecting it in 'use hardware' above\\. @@@.+?@@@", spi1.spi, "spi_ptePin");

sysctl.enable_SYSCTL_PERIPH_CLK_PMBUSA = false;
sysctl.enable_SYSCTL_PERIPH_CLK_EPG1   = false;
sysctl.enableMCD                       = true;
sysctl.enable_SYSCTL_PERIPH_CLK_HRCAL  = false;
sysctl.enable_SYSCTL_PERIPH_CLK_EQEP1  = false;
sysctl.enable_SYSCTL_PERIPH_CLK_EQEP2  = false;
sysctl.enable_SYSCTL_PERIPH_CLK_I2CA   = false;
sysctl.enable_SYSCTL_PERIPH_CLK_I2CB   = false;
sysctl.enable_SYSCTL_PERIPH_CLK_CANA   = false;
